## config/west.yml
```yaml
manifest:
  remotes:
    - name: zmkfirmware
      url-base: https://github.com/zmkfirmware
    - name: zampierilucas
      url-base: https://github.com/zampierilucas
    - name: englmaxi
      url-base: https://github.com/englmaxi
  projects:
    - name: zmk
      remote: zampierilucas
      revision: feat/individual-hid-battery-reporting-v2
      import: app/west.yml
    - name: zmk-dongle-display
      remote: englmaxi
      revision: main # use 'v0.3' instead of 'main' if you use have pinned zmk to 'v0.3' or below
  self:
    path: config
```
